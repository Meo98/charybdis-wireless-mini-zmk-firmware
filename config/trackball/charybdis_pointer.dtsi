#include <input/processors.dtsi>
#include <dt-bindings/zmk/input_transform.h>

/*
 * Die Zahlen in `layers = <...>` sind Ebenen-IDs, keine Positionen.
 * ZMK vergibt IDs beim Kompilieren in Quelltext-Reihenfolge; sie
 * bleiben fest, auch wenn die Reihenfolge in ZMK Studio geaendert wird
 * (siehe zmk_keymap_layer_active(zmk_keymap_layer_id_t)).
 * Diese Werte also NICHT an eine umsortierte Anzeige anpassen.
 *
 *   ID 6 = SLOW   ID 7 = SCROLL
 *
 * Geaendert am 12.10.: Die Bremse auf der SLOW-Ebene ist entfernt.
 * Sie machte den Zeiger dort auf ein Drittel langsam, sobald man die
 * Ebene nur betrat, um an die Maustasten zu kommen -- Tempo und
 * Tastenbelegung waren aneinandergekettet, obwohl sie nichts
 * miteinander zu tun haben. SLOW laeuft jetzt wie BASE.
 *
 * Ein eigener Knopf zum Umschalten des Tempos braucht eine eigene
 * Ebene. Genau das hatte am 11.10. die Tap-Hold-Tasten lahmgelegt
 * (Ursache bis heute ungeklaert), deshalb bleibt es vorerst draussen.
 */

&trackball_listener {
    /* Grundkette auf allen Ebenen: unveraendertes Tempo. */
    input-processors = <&zip_xy_scaler 5 5>;

    /* Scrollen (ID 7) */
    scroller: scroller {
        layers           = <7>;
        input-processors = <
            &zip_xy_scaler 1 15                              // Scroll-Tempo
            &zip_xy_to_scroll_mapper                         // XY wird zu Scrollen
            &zip_scroll_transform (INPUT_TRANSFORM_Y_INVERT) // Richtung umkehren
        >;
    };
};
